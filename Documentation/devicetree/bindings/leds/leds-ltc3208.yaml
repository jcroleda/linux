## Documentation/devicetree/bindings/leds/leds-ltc3208.yaml
```yaml
# SPDX-License-Identifier: GPL-2.0
# 
%YAML 1.2
---
$id: http://devicetree.org/schemas/leds/leds-ltc3208.yaml#
$schema: http://devicetree.org/meta-schemas/core.yaml#

title: LTC3208 Multidisplay LED Controller from Linear Technologies (Now Analog Devices).

maintainers:
  - Jan Carlo Roleda <jancarlo.roleda@analog.com>

description:
  The LTC3208 is a multidisplay LED controller that can support up to 1A to all
  connected LEDs.

  The datasheet for this device can be found in:
    https://www.analog.com/en/products/ltc3208.html


properties:
  compatible:
    const: adi,ltc3208

  reg:
    maxItems: 1

  "#address-cells":
    const: 1

  "#size-cells":
    const: 0

  patternProperties:
    "^led@[0-7]$":
      type: object
      $ref: common.yaml#
      unevaluatedProperties: false

      properties:
        reg:
          description: |
            LED Channel Number:
            0 - Main Channel (8-bit brightness)
            1 - Sub Channel (8-bit brightness)
            2 - AUX Channel (4-bit brightness)
            3 - Camera Channel, Low-side byte (4-bit brightness)
            4 - Camera Channel, High-side byte (4-bit brightness)
            5 - Red Channel (4-bit brightness)
            6 - Blue Channel (4-bit brightness)
            7 - Green Channel (4-bit brightness)
          minimum: 0
          maximum: 7

        label:
          description: LED Channel name
  
required:
  - compatible
  - reg

additionalProperties: false

examples:
- |
  #include <dt-bindings/leds/common.h>
  
  i2c {
    #address-cels = <1>;
    #size-cells = <0>;

    led-controller@0 {
      compatible = "lltc;ltc3208";
      reg = <0x1B>;
      #address-cells = <1>;
      #sizecells = <0>;

      led@0 {
        reg = <0>;
        label = "ltc3208:main";
        function = LED_FUNCTION_BACKLIGHT;
      };

      led@1 {
        reg = <1>;
        label = "ltc3208:sub";
        function = LED_FUNCTION_BACKLIGHT;
      };

      led@2 {
        reg = <2>;
        label = "ltc3208:aux";
      };

      led@3 {
        reg = <3>;
        label = "ltc3208:cam_lo";
        function = LED_FUNCTION_FLASH;
      };

      led@4 {
        reg = <4>;
        label = "ltc3208:cam_hi";
        function = LED_FUNCTION_FLASH;
      };

      led@5 {
        reg = <5>;
        label = "ltc3208:red";
        color = LED_COLOR_ID_RED;
      };

      led@6 {
        reg = <6>;
        label = "ltc3208:blue";
        color = LED_COLOR_ID_GREEN;
      };

      led@7 {
        reg = <7>;
        label = "ltc3208:green";
        color = LED_COLOR_ID_BLUE;
      };
    };
  };
```
